## Kconfig
```kconfig
menu "ODDA APP menu"
	
	comment "Options"

	choice APP_MODE
		prompt "Application mode"
		default DEMO

		config DEMO
			bool "Demo Mode"

	endchoice

endmenu

source "$(GAP_SDK_HOME)/utils/kconfig/Kconfig"
```
